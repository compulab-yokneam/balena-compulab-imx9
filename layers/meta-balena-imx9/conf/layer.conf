## layers/meta-balena-imx9/conf/layer.conf
```bitbake
BBPATH .= ":${LAYERDIR}"

BBFILES += "${LAYERDIR}/recipes-*/*/*.bb \
            ${LAYERDIR}/recipes-*/*/*.bbappend"

BBFILE_COLLECTIONS += "balena-imx9"
BBFILE_PATTERN_balena-imx9 := "^${LAYERDIR}/"
BBFILE_PRIORITY_balena-imx9 = "1337"
LAYERSERIES_COMPAT_balena-imx9 = "scarthgap"

BBMASK += "meta-imx/meta-imx-bsp/recipes-connectivity/connman/"
BBMASK += "meta-imx/meta-imx-bsp/recipes-multimedia/pipewire/"
BBMASK += "meta-imx/meta-imx-bsp/recipes-multimedia/wireplumber/"
BBMASK += "meta-bsp-imx9/recipes-fsl/images/"
BBMASK += "meta-bsp-imx9/recipes-desktop/cl-deploy/"
BBMASK += "recipes-bsp/firmware-imx/firmware-ele-imx_1.3.0.bbappend"

KERNEL_IMAGETYPE:compulab-mx93 = "Image.gz"
KERNEL_PACKAGE_NAME="kernel"

HOSTTOOLS:remove = " git-lfs "
HOSTTOOLS:remove = " bison "

MACHINE_FEATURES:remove = "optee"
```
